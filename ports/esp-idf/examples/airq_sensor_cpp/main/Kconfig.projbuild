## ports/esp-idf/examples/airq_sensor_cpp/main/Kconfig.projbuild
```kconfig
menu "simple-matter airq_sensor example"

    config SM_WIFI_SSID
        string "WiFi SSID"
        default "my-ssid"
        help
            接続先 WiFi の SSID。ビルドを通すためのプレースホルダ。**起動時に自動
            接続はしない**(BLE コミッショニングで投入された資格情報のみ join)。
            BLE 無効ビルドのフォールバック経路でのみ使う。

    config SM_WIFI_PASSWORD
        string "WiFi password"
        default "my-password"
        help
            WiFi パスフレーズ(WPA2-PSK)。SM_WIFI_SSID と同じくフォールバック用。

    config SM_I2C_SDA_GPIO
        int "Sensor I2C SDA GPIO"
        default 11
        help
            SEN55 / SCD40 が載る I2C バスの SDA(M5Stack AirQ = GPIO11)。

    config SM_I2C_SCL_GPIO
        int "Sensor I2C SCL GPIO"
        default 12
        help
            SEN55 / SCD40 が載る I2C バスの SCL(M5Stack AirQ = GPIO12)。

    config SM_SEN55_POWER_GPIO
        int "SEN55 power control GPIO (-1 to disable)"
        default 10
        help
            SEN55 のロードスイッチ(M5Stack AirQ = GPIO10、LOW で ON)。-1 で無効
            (電源制御なし = 常時給電ボード)。

    config SM_POWER_HOLD_GPIO
        int "Battery power-hold GPIO (-1 to disable)"
        default 46
        help
            バッテリー動作時の電源維持(M5Stack AirQ = GPIO46、HIGH で HOLD)。
            USB 給電では無害。-1 で無効。

    config SM_FACTORY_DATA
        bool "Use factory data partition (esp-matter-mfg-tool compatible)"
        default n
        help
            esp-matter-mfg-tool 生成の factory NVS パーティション(chip-factory
            namespace)から DAC/PAI/DAC 鍵・SPAKE2+ verifier・discriminator・VID/PID を
            読み、sm_config_t に供給する。未 flash / 失敗時は dev 定数へフォールバック。

    config SM_FACTORY_PARTITION
        string "Factory data partition label"
        default "nvs_factory"
        depends on SM_FACTORY_DATA

    config SM_ENABLE_BLE
        bool "Enable BLE (NimBLE) commissioning"
        default y
        help
            BLE(NimBLE)給餌によるコミッショニング(pairing ble-wifi)を有効にする。
            有効時は起動時 WiFi join を止め、ConnectNetwork 駆動でプロビジョンする。
            AirQ は BLE + WiFi coex を前提にするため既定 y。

endmenu
```

## ports/esp-idf/examples/generic_matter_cpp/main/Kconfig.projbuild
```kconfig
menu "simple-matter generic_matter example"

    choice SM_NETWORK_TYPE
        prompt "Operational network transport"
        default SM_NETWORK_WIFI
        help
            プリセット NetworkCommissioning の種別(docs/design/c-ffi-shim.md §10)。
            wifi = pairing ble-wifi(既定)、thread = pairing ble-thread(esp_openthread)。
            択一。thread は ESP32-C6 の 802.15.4 + BLE coex を使う。

        config SM_NETWORK_WIFI
            bool "WiFi (pairing ble-wifi)"

        config SM_NETWORK_THREAD
            bool "Thread (pairing ble-thread, esp_openthread)"
            depends on IDF_TARGET_ESP32C6
    endchoice

    config SM_WIFI_SSID
        string "WiFi SSID"
        default "my-ssid"
        depends on SM_NETWORK_WIFI
        help
            接続先 WiFi の SSID。ビルドを通すためのプレースホルダ。実機では
            menuconfig / sdkconfig.local で上書きする(秘密は default に書かない)。

    config SM_WIFI_PASSWORD
        string "WiFi password"
        default "my-password"
        depends on SM_NETWORK_WIFI
        help
            WiFi パスフレーズ(WPA2-PSK)。プレースホルダ。

    config SM_DEFAULT_GPIO
        int "Default gpio_out pin (used when NVS smgen/bind is unset)"
        default 48 if IDF_TARGET_ESP32S3
        default 7
        help
            NVS に binding TLV(smgen/bind)が無いときの既定バインディング
            「EP1 OnOff -> gpio_out」のピン番号。既定は M5 NanoC6 の GPIO7
            (ESP32-S3 は DevKitC の RGB LED = GPIO48)。運用では cfg-bind で
            上書きする(再ビルド不要)。

    config SM_SCRIPT_PARTITION
        string "Script partition label"
        default "smscript"
        help
            スクリプト(WASM)格納用 raw パーティションのラベル。2 スロット構成で
            各スロット先頭 16B が "SMWS" ヘッダ(docs/design/generic-firmware.md §9.3)。

    config SM_SCRIPT_ENABLE
        bool "Enable WASM scripting (WAMR)"
        default y
        help
            WASM(WAMR)スクリプト VM を組み込む(§9.3 / Phase C)。n にすると WAMR も
            静的ヒーププールもリンクされず、Phase B と同じフットプリントに戻る。
            スクリプトイメージが無いデバイスは y のままでも従来どおり動作する
            (フックは全て no-op)。

    config SM_SCRIPT_POOL_KB
        int "WAMR heap pool size (KB)"
        default 80
        depends on SM_SCRIPT_ENABLE
        help
            WAMR に渡すヒーププール。線形メモリ(既定 64KB = 1 page)+ モジュール +
            実行スタックが全てここから確保される(WAMR には malloc を渡さない =
            スクリプトがシステムヒープを食い潰せない)。

    config SM_SCRIPT_POOL_STATIC
        bool "Reserve the WAMR pool statically (BSS)"
        default n
        depends on SM_SCRIPT_ENABLE
        help
            y = プールを .bss に静的確保する(確保失敗が起き得ない代わりに、スクリプトを
            積んでいないデバイスでも RAM を占有する)。n(既定)= スクリプトイメージが
            見つかったときだけ内部 RAM から 1 度だけ確保する(失敗したら解放して
            スクリプト無しで起動)。C6 の WiFi+BLE+Matter 構成では 96KB の常時占有が
            ヒープを圧迫するため既定は n。

    config SM_SCRIPT_MAX_KB
        int "Max script image size (KB)"
        default 24
        depends on SM_SCRIPT_ENABLE
        help
            パーティションから読み出す .wasm の上限。読み出しバッファはロード時だけ
            確保して、プールへ複製したら解放する。

    config SM_SCRIPT_STACK_KB
        int "WASM execution stack (KB)"
        default 8
        depends on SM_SCRIPT_ENABLE

    config SM_SCRIPT_BUDGET_MS
        int "Per-hook wall clock budget (ms)"
        default 50
        depends on SM_SCRIPT_ENABLE
        help
            1 フックあたりの壁時計上限。超過すると esp_timer コールバックから
            wasm_runtime_terminate で trap を上げてフックを打ち切る(§9.3)。
            0 = 無制限(非推奨)。

    config SM_SCRIPTSTORE_ENABLE
        bool "Enable the ScriptStore vendor cluster (script OTA)"
        default y
        depends on SM_SCRIPT_ENABLE
        help
            vendor クラスタ ScriptStore(0xFFF1FC01)を CustomCluster として登録し、
            Begin/Data/Commit/Abort でスクリプトイメージを非 active スロットへ
            転送できるようにする(§9.4 / Phase D)。Commit で CRC 検証 → ヘッダ書き込み
            → VM 再ロード(失敗時は旧スロットへロールバック)。
            認可はシム既定(invoke = Operate)。

    config SM_SCRIPTSTORE_EP
        int "Endpoint hosting the ScriptStore cluster"
        default 1
        depends on SM_SCRIPTSTORE_ENABLE
        help
            ScriptStore を載せるエンドポイント。既定 1(合成構成に必ず存在する EP へ
            相乗りする)。合成 EP へカスタムクラスタを足す形になるので、Descriptor の
            ServerList はシムが自動でマージする(F4b)。

    config SM_FACTORY_DATA
        bool "Use factory data partition (esp-matter-mfg-tool compatible)"
        default n
        help
            esp-matter-mfg-tool 生成の factory NVS パーティション(chip-factory
            namespace)から DAC/PAI/DAC 鍵・SPAKE2+ verifier・discriminator・VID/PID を
            読み、sm_config_t に供給する(docs/design/factory-data.md §5)。
            パーティション未 flash / 読み取り失敗時は開発用の dev 定数にフォールバックする。

    config SM_FACTORY_PARTITION
        string "Factory data partition label"
        default "nvs_factory"
        depends on SM_FACTORY_DATA
        help
            factory データ NVS パーティションのラベル(partitions.csv のエントリ名)。

    config SM_ENABLE_BLE
        bool "Enable BLE (NimBLE) commissioning"
        default y if IDF_TARGET_ESP32C6
        default y if SM_NETWORK_THREAD
        default n
        help
            BLE(NimBLE)給餌によるコミッショニング(pairing ble-wifi / ble-thread)を
            有効にする(docs/design/c-ffi-shim.md §9・§10)。有効時は起動時 WiFi join を
            止め、ConnectNetwork 駆動でプロビジョンする。ESP32-S3 は既定 n。

endmenu
```

## ports/esp-idf/examples/onoff_light_cpp/main/Kconfig.projbuild
```kconfig
menu "simple-matter onoff_light example"

    choice SM_NETWORK_TYPE
        prompt "Operational network transport"
        default SM_NETWORK_WIFI
        help
            プリセット NetworkCommissioning の種別(docs/design/c-ffi-shim.md §10)。
            wifi = pairing ble-wifi(既定)、thread = pairing ble-thread(esp_openthread)。
            択一。thread は ESP32-C6 の 802.15.4 + BLE coex を使う。

        config SM_NETWORK_WIFI
            bool "WiFi (pairing ble-wifi)"

        config SM_NETWORK_THREAD
            bool "Thread (pairing ble-thread, esp_openthread)"
            depends on IDF_TARGET_ESP32C6
    endchoice

    config SM_WIFI_SSID
        string "WiFi SSID"
        default "my-ssid"
        depends on SM_NETWORK_WIFI
        help
            接続先 WiFi の SSID。ビルドを通すためのプレースホルダ。実機では
            menuconfig で上書きする。

    config SM_WIFI_PASSWORD
        string "WiFi password"
        default "my-password"
        depends on SM_NETWORK_WIFI
        help
            WiFi パスフレーズ(WPA2-PSK)。

    config SM_LED_GPIO
        int "OnOff LED GPIO"
        default 48 if IDF_TARGET_ESP32S3
        default 7
        help
            OnOff 状態を反映する LED の GPIO 番号。既定は M5 NanoC6 の GPIO7
            (ESP32-S3 は DevKitC の RGB LED = GPIO48)。

    config SM_BUTTON_GPIO
        int "Local toggle button GPIO (-1 to disable)"
        default -1 if IDF_TARGET_ESP32S3
        default 9
        help
            本体ボタンで OnOff をローカルトグルするための GPIO 番号
            (docs/design/p4-thread-controller.md §15)。既定は M5 NanoC6 の
            BOOT ボタン = GPIO9(active-low、内部プルアップ)。-1 で無効。
            ESP32-S3 DevKitC は既定 -1(ボタンなし想定)。

    config SM_FACTORY_DATA
        bool "Use factory data partition (esp-matter-mfg-tool compatible)"
        default n
        help
            esp-matter-mfg-tool 生成の factory NVS パーティション(chip-factory
            namespace)から DAC/PAI/DAC 鍵・SPAKE2+ verifier・discriminator・VID/PID を
            読み、sm_config_t に供給する(docs/design/factory-data.md §5)。
            パーティションラベルは SM_FACTORY_PARTITION。パーティション未 flash /
            読み取り失敗時は開発用の dev 定数にフォールバックする(後方互換)。
            CD(cert-dclrn)が factory に無い場合は埋め込み dev CD を使う。

    config SM_FACTORY_PARTITION
        string "Factory data partition label"
        default "nvs_factory"
        depends on SM_FACTORY_DATA
        help
            factory データ NVS パーティションのラベル(partitions.csv のエントリ名)。
            esp-matter-mfg-tool 生成の *-partition.bin をこのパーティションに flash する。

    config SM_ENABLE_BLE
        bool "Enable BLE (NimBLE) commissioning"
        default y if IDF_TARGET_ESP32C6
        default y if SM_NETWORK_THREAD
        default n
        help
            BLE(NimBLE)給餌によるコミッショニング(pairing ble-wifi / ble-thread)を
            有効にする(docs/design/c-ffi-shim.md §9・§10)。有効時は起動時 WiFi join を
            止め、ConnectNetwork 駆動でプロビジョンする。Thread 構成では必須
            (ble-thread のコミッショニング経路)なので既定 y。ESP32-S3 は既定 n
            (従来の UDP 直接 PASE のみ)。

endmenu
```

## ports/esp-idf/examples/tab5_ctrl_app/main/Kconfig.projbuild
```kconfig
menu "tab5_ctrl_app configuration"

    comment "RCP (ESP32-H2) connection -- defaults are the values confirmed on hardware (P9)"

    config SM_OT_UART_PORT
        int "UART port to the 802.15.4 RCP"
        default 1
        help
            H2(ot_rcp)と spinel をやり取りする P4 側の UART ポート番号。
            UART0 はコンソールに使うため既定は 1。

    config SM_OT_UART_RX_PIN
        int "UART RX pin (P4 side, connect to RCP TX)"
        default 54
        help
            M5Stack Tab5 の Port A(Grove)の RX = GPIO54。実機 P9 で確定
            (53/54 を逆にすると spinel が無応答になる)。

    config SM_OT_UART_TX_PIN
        int "UART TX pin (P4 side, connect to RCP RX)"
        default 53
        help
            M5Stack Tab5 の Port A(Grove)の TX = GPIO53。実機 P9 で確定。

    config SM_OT_UART_BAUD
        int "UART baud rate to the RCP"
        default 460800
        help
            scripts/otbr/build-ot-rcp-h2.sh でビルドする RCP 側の設定と一致させること。

    comment "Thread network"

    config SM_THREAD_DATASET_TLV_HEX
        string "Active dataset TLV (hex, empty = create a new network)"
        default ""
        help
            空にすると起動時に otDatasetCreateNewNetwork で新規ネットワークを生成する
            (生成された TLV は起動ログと画面の Network タブに出る)。
            NVS に保存済みの dataset があればそちらが優先される。

    comment "WiFi (on-board ESP32-C6 over SDIO -- esp_hosted / esp_wifi_remote)"

    config SM_WIFI_SSID
        string "WiFi SSID (empty = WiFi disabled, Thread only)"
        default ""
        help
            空にすると sm_wifi_start() が何もせず戻る(Thread だけで動く)。
            C6 の slave FW が esp_hosted 2.x でない個体では、ここを設定しても
            SDIO の CMD5 が通らず初期化に失敗する(画面の WiFi 表示が "failed")。

    config SM_WIFI_PASSWORD
        string "WiFi password (empty = open AP)"
        default ""

    comment "Matter"

    config SM_TARGET_PORT
        int "Matter UDP port of the devices"
        default 5540
        help
            PASE / CASE の宛先ポート。標準は 5540。

    config SM_UI_DEFAULT_PASSCODE
        int "Default passcode shown in the pair dialog"
        default 20202021

    config SM_UI_DEFAULT_NODE_ID
        hex "First NodeId offered by the pair dialog"
        default 0xAABBCCDD
        help
            Pair ダイアログの NodeId 初期値。既に同じ ID のノードが居る場合は
            +1 して自動採番する(ダイアログ上で編集も可)。

    config SM_UI_FALLBACK_NODE_ID
        hex "Fallback NodeId when the node book blob cannot be parsed"
        default 0xAABBCCDD
        help
            NVS の "smctl"/"nods" が読めないのにシムがノードを持っている場合、
            この NodeId だけ sm_ctrl_node_addr で当たりを取って一覧に出す
            (実機の NanoC6 = 0xaabbccdd の救済)。

endmenu
```

## ports/esp-idf/examples/thread_ctrl_hub_cpp/main/Kconfig.projbuild
```kconfig
menu "thread_ctrl_hub_cpp configuration"

    comment "RCP (ESP32-H2) connection"

    config SM_OT_UART_PORT
        int "UART port to the 802.15.4 RCP"
        default 1
        help
            H2(ot_rcp)と spinel をやり取りする P4 側の UART ポート番号。
            UART0 はコンソールに使うため既定は 1。

    config SM_OT_UART_RX_PIN
        int "UART RX pin (P4 side, connect to RCP TX)"
        default 4

    config SM_OT_UART_TX_PIN
        int "UART TX pin (P4 side, connect to RCP RX)"
        default 5

    config SM_OT_UART_BAUD
        int "UART baud rate to the RCP"
        default 460800
        help
            scripts/otbr/build-ot-rcp-h2.sh でビルドする RCP 側の設定と一致させること。

    comment "Thread network"

    config SM_THREAD_DATASET_TLV_HEX
        string "Active dataset TLV (hex, empty = create a new network)"
        default ""
        help
            空にすると起動時に otDatasetCreateNewNetwork で新規ネットワークを生成する
            (生成された TLV は起動ログに hex で出るので、デバイス側にプリセットする)。
            既存の Thread ネットワークに合わせる場合はその active dataset TLV を hex で
            指定する。NVS に保存済みの dataset があればそちらが優先される。

    config SM_THREAD_BR
        bool "Enable border routing over a backbone netif (F8e, best effort)"
        default n
        help
            有効にすると backbone(WiFi/Ethernet)側と Thread の間で border routing を
            行う(esp_openthread_border_router_init)。P4 は radio 非搭載のため backbone
            WiFi は esp_wifi_remote / esp-hosted(例: M5Stack Tab5 = P4+C6)が要る。
            既定 n = 自己完結 Thread ハブ(Matter 通信に border routing は不要)。

    config SM_BACKBONE_WIFI_SSID
        string "Backbone WiFi SSID"
        depends on SM_THREAD_BR
        default "CHANGE-ME"
        help
            秘密はコミットしない。sdkconfig.local で上書きすること。

    config SM_BACKBONE_WIFI_PASS
        string "Backbone WiFi password"
        depends on SM_THREAD_BR
        default "CHANGE-ME"
        help
            秘密はコミットしない。sdkconfig.local で上書きすること。

    comment "Target device (Matter)"

    config SM_TARGET_NODE_ID
        hex "Target node id (operational NodeId)"
        default 0xAABBCCDD
        help
            コミッショニングして管理する固定ノードの運用 NodeId。

    config SM_TARGET_PASSCODE
        int "Target passcode"
        default 20202021

    config SM_TARGET_IPV6
        string "Target device IPv6 (on-network PASE over Thread)"
        default "fd00:db8:a0:0::1"
        help
            未コミッショニング時に PASE を張る宛先。デバイスを同じ dataset で Thread に
            参加させ、そのログに出る ML-EID / OMR アドレスを転記する。
            BLE を使わない構成のため、コミッショニングは on-network PASE で行う。

    config SM_TARGET_PORT
        int "Target device Matter UDP port"
        default 5540

endmenu
```
